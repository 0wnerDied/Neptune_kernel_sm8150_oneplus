/* Copyright (c) 2021, Qualcomm Innovation Center, Inc. All rights reserved.
 *
 * This program is free software; you can redistribute it and/or modify
 * it under the terms of the GNU General Public License version 2 and
 * only version 2 as published by the Free Software Foundation.
 *
 * This program is distributed in the hope that it will be useful,
 * but WITHOUT ANY WARRANTY; without even the implied warranty of
 * MERCHANTABILITY or FITNESS FOR A PARTICULAR PURPOSE.  See the
 * GNU General Public License for more details.
 */

/dts-v1/;

#include "qcs410-2gb.dtsi"

/ {
	model = "Qualcomm Technologies, Inc. QCS410 SoC 2GB";
	compatible = "qcom,qcs410";
	qcom,board-id = <0 0x400>;
};
